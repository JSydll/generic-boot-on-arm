## meta-generic-boot/conf/layer.conf
```bitbake
BBPATH .= ":${LAYERDIR}"
BBFILES += "${LAYERDIR}/recipes-*/*/*.bb \
            ${LAYERDIR}/recipes-*/*/*.bbappend"

BBFILE_COLLECTIONS += "meta-generic-boot"
BBFILE_PATTERN_meta-generic-boot = "^${LAYERDIR}/"
BBFILE_PRIORITY_meta-generic-boot = "14"

LAYERDEPENDS_meta-generic-boot = "core"
LAYERSERIES_COMPAT_meta-generic-boot = "walnascar whinlatter"

BBMASK:virt-aarch64 += "u-boot-toradex"
BBMASK:virt-aarch64 += "linux-toradex-upstream"
```

## meta-generic-boot/conf/machine/virt-aarch64.conf
```bitbake
# Custom virtual (QEMU) machine aiming for a close match of the target hardware
# 
# Heavily based on poky's qemuarm64 machine but with adjustments for 
# - runqemu configuration support
require conf/machine/include/arm/armv8a/tune-cortexa72.inc
require conf/machine/include/qemu.inc

# General
# ----
MACHINEOVERRIDES =. "qemuarm64:"

KERNEL_IMAGETYPE = "Image"
KMACHINE:virt-aarch64 = "qemuarm64"
UBOOT_MACHINE = "qemu_arm64_defconfig"

SERIAL_CONSOLES = "115200;ttyAMA0 115200;hvc0"

FIRMWARE_BINARY ??= "flash.bin"

# Bootloader (BL33)
PREFERRED_PROVIDER_virtual/bootloader = "u-boot"

# UEFI-based (secure) boot
# efi - feature defined and used across poky, e.g. mentioned in uki.bbclass.
# uefi-secureboot - feature provided by meta-arm layers, pulls in secure-boot related configurations.
MACHINE_FEATURES:append = " efi uefi-secureboot"

# QEMU config
# ----
QB_SYSTEM_NAME = "qemu-system-aarch64"
QB_MACHINE = "-machine virt,secure=on"
QB_CPU_VALUE = "cortex-a72"
QB_CPU = "-cpu ${QB_CPU_VALUE}"
QB_MEM_VALUE = "4G"
QB_MEM = "-m ${QB_MEM_VALUE}"
QB_MMC_SIZE = "2G"
QB_SMP = "-smp 4"
QB_CPU_KVM = "-cpu host -machine gic-version=3"
QB_TAP_OPT = "-netdev tap,id=net0,ifname=@TAP@,script=no,downscript=no"
QB_NETWORK_DEVICE = "-device virtio-net-pci,netdev=net0,mac=@MAC@"
QB_SERIAL_OPT = "-device virtio-serial-pci -chardev null,id=virtcon -device virtconsole,chardev=virtcon"
QB_TCPSERIAL_OPT = "-device virtio-serial-pci -chardev socket,id=virtcon,port=@PORT@,host=127.0.0.1,nodelay=on -device virtconsole,chardev=virtcon"
QB_ROOTFS_OPT = "-drive if=none,file=@ROOTFS@,format=qcow2,id=MMC0 -device sdhci-pci,sd-spec-version=3 -device sd-card,drive=MMC0"
# pseudo-secure boot
QB_KERNEL_ROOT = ""
QB_DEFAULT_KERNEL = "none"
QB_DEFAULT_BIOS = "${FIRMWARE_BINARY}"
```
